## main/Kconfig.projbuild
```kconfig
menu "Example Configuration"

    config ESP_WIFI_SSID_STA
        string "WiFi SSID STA"
        default "myssid"
        help
            SSID (network name) for the example STA to connect to.

    config ESP_WIFI_PASSWORD_STA
        string "WiFi Password STA"
        default "mypassword"
        help
            WiFi password (WPA or WPA2) for the example STA to use.

    config ESP_WIFI_SSID_AP
        string "WiFi SSID AP"
        default "myssid"
        help
            SSID (network name) for the example AP to connect to.

    config ESP_WIFI_PASSWORD_AP
        string "WiFi Password AP"
        default "mypassword"
        help
            WiFi password (WPA or WPA2) for the example AP to use.
            
    config ESP_WIFI_CHANNEL_AP
        int "WiFi Channel AP"
        range 1 13
        default 1
        help
            WiFi channel (network channel) for the example to use.
            
   config ESP_MAXIMUM_RETRY
        int "Maximum retry"
        default 5
        help
            Set the Maximum retry to avoid station reconnecting to the AP unlimited when the AP is really inexistent.

    config ESP_MAX_STA_CONN
        int "Maximal STA connections"
        default 4
        help
            Max number of the STA connects to AP.
    
    config EXAMPLE_SCAN_LIST_SIZE
        int "Max size of scan list"
        range 0 20
        default 10
        help
            The size of array that will be used to retrieve the list of access points.
            
endmenu
```
